## app/boards/arm/mask/Kconfig
```kconfig
# Copyright (c) 2021 Nick Winans
# Copyright (c) 2021 Marco Sterbik
# SPDX-License-Identifier: MIT

config BOARD_ENABLE_DCDC
	bool "Enable DCDC mode"
	select SOC_DCDC_NRF53X_APP
	default y
	depends on BOARD_MASK
```

## app/boards/arm/mask/Kconfig.board
```kconfig
# Copyright (c) 2021 Nick Winans
# Copyright (c) 2021 Marco Sterbik
# SPDX-License-Identifier: MIT

config BOARD_MASK
	bool "mask"
	depends on SOC_NRF5340_CPUAPP_QKAA
```

## app/boards/arm/mask/Kconfig.defconfig
```kconfig
# Copyright (c) 2021 Nick Winans
# Copyright (c) 2021 Marco Sterbik
# SPDX-License-Identifier: MIT

if BOARD_MASK

config ZMK_KEYBOARD_NAME
	default "mask"

if USB

config USB_NRFX
	default y

config USB_DEVICE_STACK
	default y


endif # USB

config BT_CTLR
	default BT

config ZMK_BLE
	default n

config ZMK_USB
	default y

config ZMK_BATTERY_VOLTAGE_DIVIDER
	default n

endif # BOARD_MASK
```

## app/boards/arm/mask/mask_defconfig
```kconfig
# Copyright (c) 2021 Nick Winans
# Copyright (c) 2021 Marco Sterbik
# SPDX-License-Identifier: MIT

CONFIG_SOC_SERIES_NRF53X=y
CONFIG_SOC_NRF5340_CPUAPP_QKAA=y
CONFIG_BOARD_MASK=y

# Enable MPU
CONFIG_ARM_MPU=y

# enable GPIO
CONFIG_GPIO=y

CONFIG_USE_DT_CODE_PARTITION=y

CONFIG_MPU_ALLOW_FLASH_WRITE=y
CONFIG_NVS=y
CONFIG_SETTINGS_NVS=y
CONFIG_FLASH=y
CONFIG_FLASH_PAGE_LAYOUT=y
CONFIG_FLASH_MAP=y

CONFIG_ZMK_RGB_UNDERGLOW=n
CONFIG_WS2812_STRIP=n

CONFIG_CLOCK_CONTROL_NRF_K32SRC_SYNTH=y

#CONFIG_LOG=y
#CONFIG_ZMK_USB_LOGGING=y
#CONFIG_LOG_BACKEND_RTT=y
```

## app/boards/arm/mask/mask_left_defconfig
```kconfig
# SPDX-License-Identifier: Apache-2.0

CONFIG_SOC_SERIES_NRF53X=y
CONFIG_SOC_NRF5340_CPUAPP_QKAA=y
CONFIG_BOARD_MASK_LEFT=y

# Enable MPU
CONFIG_ARM_MPU=y

# Enable hardware stack protection
CONFIG_HW_STACK_PROTECTION=y

# Enable TrustZone-M
CONFIG_ARM_TRUSTZONE_M=y

# enable GPIO
CONFIG_GPIO=y

# Enable uart driver
CONFIG_SERIAL=n

# enable console
CONFIG_CONSOLE=y
CONFIG_UART_CONSOLE=y

CONFIG_USB_DEVICE_STACK=y
CONFIG_USB_NRFX=y
CONFIG_CLOCK_CONTROL_NRF_K32SRC_RC=y
CONFIG_CLOCK_CONTROL_NRF_K32SRC_RC_CALIBRATION=y
CONFIG_CLOCK_CONTROL_NRF_K32SRC_250PPM=y


CONFIG_MPU_ALLOW_FLASH_WRITE=y
CONFIG_NVS=y
CONFIG_SETTINGS_NVS=y
CONFIG_FLASH=y
CONFIG_FLASH_PAGE_LAYOUT=y
CONFIG_FLASH_MAP=y

#CONFIG_ZMK_USB=y
CONFIG_ZMK_RGB_UNDERGLOW=n
#CONFIG_ZMK_SPLIT=n
CONFIG_WS2812_STRIP=n
```

## app/boards/arm/mask_module/Kconfig.board
```kconfig
# mask_module board configuration

# Copyright (c) 2020 Pete Johanson
# SPDX-License-Identifier: MIT

config BOARD_MASK_MODULE
	bool "mask_module"
	depends on SOC_NRF52840_QIAA
```

## app/boards/arm/mask_module/Kconfig.defconfig
```kconfig
# Copyright (c) 2021 The ZMK Contributors
# SPDX-License-Identifier: MIT

if BOARD_MASK_MODULE

config BOARD
	default "mask_module"

if USB_DEVICE_STACK

config USB_NRFX
	default y

endif # USB_DEVICE_STACK

config BT_CTLR
	default BT

config ZMK_BLE
	default y

config ZMK_USB
	default y

endif # BOARD_MASK_MODULE
```

## app/boards/shields/mask-v1/Kconfig.shield
```kconfig
# Copyright (c) 2020 Ryan Cross
# SPDX-License-Identifier: MIT

config SHIELD_MASK_V1_LEFT
	def_bool $(shields_list_contains,mask_v1_left)

config SHIELD_MASK_V1_RIGHT
	def_bool $(shields_list_contains,mask_v1_right)
```

## app/boards/shields/mask-v2/Kconfig.defconfig
```kconfig
# Copyright (c) 2020 Ryan Cross
# SPDX-License-Identifier: MIT

if SHIELD_MASK_V2_LEFT

config ZMK_KEYBOARD_NAME
	default "mask"

config ZMK_SPLIT_ROLE_CENTRAL
	default y
	
endif

if SHIELD_MASK_V2_LEFT || SHIELD_MASK_V2_RIGHT

config ZMK_SPLIT
	default y

endif
```

## app/boards/shields/mask-v2/Kconfig.shield
```kconfig
# Copyright (c) 2020 Ryan Cross
# SPDX-License-Identifier: MIT

config SHIELD_MASK_V2_LEFT
	def_bool $(shields_list_contains,mask_v2_left)

config SHIELD_MASK_V2_RIGHT
	def_bool $(shields_list_contains,mask_v2_right)
```
